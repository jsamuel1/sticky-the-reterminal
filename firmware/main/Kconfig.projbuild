## firmware/main/Kconfig.projbuild
```kconfig
menu "tiny Sticky"

choice TINY_BOARD
    prompt "Target board"
    default TINY_BOARD_RETERMINAL
    help
        Which physical board this image is for. The pin map (pin_config.h),
        the HAL sources (main/CMakeLists.txt) and the capability table
        (board_caps.h) all follow this choice. The reTerminal is the default
        and the release target; the others are selected by an extra
        sdkconfig.defaults overlay (sdkconfig.defaults.<board>).

config TINY_BOARD_RETERMINAL
    bool "Seeed reTerminal Sticky (SSD1677 e-ink, 32 MB flash)"

config TINY_BOARD_FNK0104S
    bool "Freenove FNK0104S 4.0\" (ST7796 LCD, 16 MB flash)"
    help
        Display, FT6336U touch, ES8311 audio and the GPIO 9 battery ADC are
        driven. The ADC reports calibrated pack voltage plus a plausible
        resting-voltage percent estimate; SDMMC is not driven yet. Console is
        USB-Serial-JTAG (the USB-C port).

config TINY_BOARD_AMOLED18
    bool "Waveshare ESP32-S3-Touch-AMOLED-1.8 V2 (CO5300, 16 MB flash)"
    help
        Display: CO5300 368x448 QSPI AMOLED (lcd_canvas), after the TCA9554
        rails/resets come up. ES8311 audio and CST820 touch (0x15, reset on
        TCA9554 bit 2) are driven; PMU, RTC, IMU and SD are not driven yet.

endchoice

config TINY_LCD_SPI_MHZ
    int "Colour LCD SPI clock (MHz)"
    depends on TINY_BOARD_FNK0104S || TINY_BOARD_AMOLED18
    range 10 80
    default 40
    help
        Panel pixel clock on SPI2. FNK0104S ST7796 (IO_MUX pins): the vendor
        runs 80, xiaozhi 20; 40 is the tested middle. AMOLED-1.8 CO5300
        (QSPI, 4 data lines): the Waveshare BSP runs 40. Drop to 20 if the
        glass shows noise.

config TINY_STATUS_LED
    bool "WS2812 status light (listening / thinking / error)"
    depends on TINY_BOARD_FNK0104S
    default y
    help
        Drives the board's one WS2812 (GPIO42) through RMT as an ambient
        state light: blue while the mic captures, amber while the upload or
        ask is in flight, red for a few seconds after an ask fails, off
        otherwise. Dark while pocket-locked and in deep sleep. Only the
        FNK0104S has the part; every other board builds without it.

config TINY_STATUS_LED_BRIGHTNESS
    int "Status light brightness (1-64 of 255)"
    depends on TINY_STATUS_LED
    range 1 64
    default 12
    help
        Scale applied to every colour. The LED sits behind the case at
        arm's length; 12 is visible indoors without lighting the room.

config TINY_DASHBOARD_URL
    string "Dashboard base URL (settings QR target)"
    default "https://sticky.cagatay.my"
    help
        The settings page shows a QR code pointing at
        <this URL>/s/<device_id>, where a phone configures WiFi and toggles.
        It is the self-hosted dashboard under docs/dashboard; point this at
        your own deployment. The device sends no secret to it.

endmenu
```
